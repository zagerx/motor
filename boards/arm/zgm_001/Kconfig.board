## boards/arm/zgm_001/Kconfig.board
```kconfig
# 必须包含SOC系列选择
config BOARD_ZGM_001
    bool "ZGM Motor Control Board"
    depends on SOC_STM32G473XX
    select SOC_SERIES_STM32G4X  # 确保这行存在
    select HAS_DTS_GPIO_LEDS
    select HAS_DTS_SERIAL
    select HAS_STM32CUBE
```

## boards/arm/zgm_001/Kconfig.motor
```kconfig
choice
    prompt "Motor Type Selection"
    default MOTOR_GM6020
    help
      Select the motor type for this board

config MOTOR_GM6020
    bool "GM6020 (200W brushless)"
    help
      200W brushless motor with encoder

config MOTOR_M3508
    bool "M3508 (Compact brushless)"
    help
      Compact brushless motor with reducer

config MOTOR_M2006
    bool "M2006 (Small brushless)"
    help
      Small brushless motor for lightweight applications
endchoice

# 电机特性参数配置
config MOTOR_POLE_PAIRS
    int "Motor pole pairs"
    default 7 if MOTOR_GM6020
    default 4 if MOTOR_M3508
    default 4 if MOTOR_M2006
    range 1 20
    help
      Number of magnetic pole pairs in the motor

config MOTOR_MAX_RPM
    int "Maximum RPM"
    default 5000 if MOTOR_GM6020
    default 20000 if MOTOR_M3508
    default 15000 if MOTOR_M2006
    range 1000 30000
    help
      Maximum rotation speed in RPM

config MOTOR_TORQUE_CONSTANT
    float "Torque constant (Nm/A)"
    default 0.18 if MOTOR_GM6020
    default 0.12 if MOTOR_M3508
    default 0.08 if MOTOR_M2006
    help
      Motor torque constant
```

## boards/arm/zgm_001/Kconfig.zgm_001
```kconfig
# Copyright (c) 2019 Richard Osterloh <richard.osterloh@gmail.com>
# SPDX-License-Identifier: Apache-2.0

config BOARD_ZGM_001
	select SOC_STM32G431XX
```

## boards/arm/zgm_001/board.yml
```yaml
board:
  name: zgm_001
  full_name: Nucleo G431RB
  vendor: st
  socs:
    - name: stm32g431xx
```

## boards/arm/zgm_002/Kconfig.zgm_002
```kconfig
# Copyright (c) 2020 Alexander Kozhinov <ak.alexander.kozhinov@gmail.com>
# SPDX-License-Identifier: Apache-2.0

config BOARD_ZGM_002
	select SOC_STM32H723XX
    select USE_STM32_LL_TIM
```

## lib/Kconfig
```kconfig
menu "Motor Initialization Priorities"
    config MOTOR_INIT_PRIORITY
        int "Motor control device initialization priority"
        range 0 99
        default 99
        help
          Initialization priority for motor control devices (lower value = earlier init).
          Must be higher than dependent devices (FOC/PWM/Feedback).

    config FOC_INIT_PRIORITY
        int "FOC algorithm initialization priority" 
        range 0 98
        default 98
        help
          Initialization priority for FOC control algorithms.
          Must be higher than PWM/current sampling devices.

    config FEEDBACK_INIT_PRIORITY
        int "Feedback sensor initialization priority"
        range 0 97  
        default 97
        help
          Initialization priority for motor feedback sensors (encoders/hall).
          Must initialize before FOC/motor control.

    config PWMX_STM32_INIT_PRIORITY
        int "PWM driver initialization priority"
        range 0 96
        default 96  
        help
          Initialization priority for STM32 PWM drivers.
          Must initialize before current sampling/FOC.

    config CURRSMP_INIT_PRIORITY
        int "Current sampling initialization priority"
        range 0 95
        default 95
        help
          Initialization priority for current sampling devices.
          Must initialize before FOC algorithms.
endmenu
```

## lib/bldcmotor/Kconfig.motor
```kconfig
choice
    prompt "Motor Type Selection"
    default MOTOR_SUPER_ABZHALL_400W
    help
      Select the motor type for this board

config MOTOR_SUPER_ABZHALL_400W
    bool "SPUER_400 (400W brushless)"
    help
      400W brushless motor with encoder

config MOTOR_BARO_ABZHALL_750W
    bool "M3508 (Compact brushless)"
    help
      Compact brushless motor with reducer

config MOTOR_ELUR_HALL
    bool "M2006 (Small brushless)"
    help
      Small brushless motor for lightweight applications
endchoice

# 电机特性参数配置
config MOTOR_POLE_PAIRS
    int "Motor pole pairs"
    default 5 if MOTOR_SUPER_ABZHALL_400W
    default 4 if MOTOR_BARO_ABZHALL_750W
    default 2 if MOTOR_ELUR_HALL
    range 1 20
    help
      Number of magnetic pole pairs in the motor

config MOTOR_MAX_RPM
    int "Maximum RPM"
    default 3000 if MOTOR_SUPER_ABZHALL_400W
    default 3000 if MOTOR_BARO_ABZHALL_750W
    default 3000 if MOTOR_ELUR_HALL
    range 1000 30000
    help
      Maximum rotation speed in RPM

config MOTOR_TORQUE_CONSTANT
    int "Torque constant (Nm/A)"
    default 180 if MOTOR_SUPER_ABZHALL_400W
    default 120 if MOTOR_BARO_ABZHALL_750W
    default 80 if MOTOR_ELUR_HALL
    help
      Motor torque constant


# ===== 新增配置：编码器参数 =====
config ABZ_ENCODER_LINES
    int "ABZ Encoder lines (PPR)"
    default 4096
    range 100 65535
    help
      Number of pulses per revolution (PPR) for ABZ encoder

# ===== 新增配置：霍尔传感器参数 =====
config HALL_SENSOR_POSITIVE_OFFSET_CENTI
    int "Hall sensor positive offset (centi-degrees)"
    default -3000  # -30.0° * 100
    range -18000 18000  # -180° to 180°
    help
      Positive direction offset for hall sensor in centi-degrees
      (Divide by 100 to get degrees)

config HALL_SENSOR_NEGATIVE_OFFSET_CENTI
    int "Hall sensor negative offset (centi-degrees)"
    default 0
    range -18000 18000
    help
      Negative direction offset for hall sensor in centi-degrees

# ===== 新增配置：电机扇区基准角度 =====
menu "Motor Sector Base Angles (centi-degrees)"

config SECTION_1_BASEANGLE_CENTI
    int "Section 1 base angle"
    default 22600  # 226.00° * 100

config SECTION_2_BASEANGLE_CENTI
    int "Section 2 base angle"
    default 34600  # 346.00° * 100

config SECTION_3_BASEANGLE_CENTI
    int "Section 3 base angle"
    default 28600  # 286.00° * 100

config SECTION_4_BASEANGLE_CENTI
    int "Section 4 base angle"
    default 10600  # 106.00° * 100

config SECTION_5_BASEANGLE_CENTI
    int "Section 5 base angle"
    default 16600  # 166.00° * 100

config SECTION_6_BASEANGLE_CENTI
    int "Section 6 base angle"
    default 4600   # 046.00° * 100

endmenu
```

## lib/utils/Kconfig
```kconfig
config SPINNER_UTILS_STM32
	bool "STM32 utilities"
	select USE_STM32_LL_RCC
    select USE_STM32_LL_ADC
	help
	  Enable common utilities for STM32 SoCs.
```
